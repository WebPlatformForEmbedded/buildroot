## configs/sagemcomrdk_westeros_wpe_gst_full_cog_defconfig
```kconfig
BR2_arm=y
BR2_cortex_a15=y
BR2_ARM_FPU_NEON_VFPV4=y
BR2_ARM_INSTRUCTIONS_THUMB2=y
BR2_CCACHE=y
BR2_OPTIMIZE_2=y
BR2_TOOLCHAIN_BUILDROOT_GLIBC=y
BR2_KERNEL_HEADERS_5_4=y
BR2_BINUTILS_VERSION_2_33_X=y
BR2_GCC_VERSION_9_X=y
BR2_TOOLCHAIN_BUILDROOT_CXX=y
BR2_PACKAGE_HOST_GDB=y
BR2_ROOTFS_DEVICE_CREATION_DYNAMIC_EUDEV=y
BR2_TARGET_GENERIC_ROOT_PASSWD="root"
BR2_TARGET_GENERIC_GETTY_PORT="ttyS0"
BR2_ROOTFS_POST_BUILD_SCRIPT="board/sagemcom/post-build.sh"
BR2_ROOTFS_POST_IMAGE_SCRIPT="board/sagemcom/sagemcom.sh"
BR2_LINUX_KERNEL=y
BR2_LINUX_KERNEL_CUSTOM_GIT=y
BR2_LINUX_KERNEL_CUSTOM_REPO_URL="git@github.com:Metrological/bcm-stblinux-5.git"
BR2_LINUX_KERNEL_CUSTOM_REPO_VERSION="0e8da3c816111633c43d5bab9dc2f3bdfc6f4ea1"
BR2_LINUX_KERNEL_DEFCONFIG="brcmstb"
BR2_LINUX_KERNEL_CONFIG_FRAGMENT_FILES="board/bcm/config-fragments/cgroups.cfg board/bcm/config-fragments/ipv6.cfg board/bcm/config-fragments/netfilter.cfg board/bcm/config-fragments/wpa-supplicant.cfg board/bcm/config-fragments/no-vdso.cfg board/bcm/config-fragments/bt.cfg"
BR2_PACKAGE_GST1_BCM=y
BR2_PACKAGE_GST1_BCM_ENABLE_SVP=y
BR2_PACKAGE_PULSEAUDIO=y
BR2_PACKAGE_GDB=y
BR2_PACKAGE_BITSTREAM_VERA=y
BR2_PACKAGE_COG=y
BR2_PACKAGE_WESTEROS=y
BR2_PACKAGE_SDK_RDKVA_SAGEMCOM=y
BR2_PACKAGE_CA_CERTIFICATES=y
BR2_PACKAGE_LIBDRM=y
BR2_PACKAGE_WPEWEBKIT_ENABLE_NATIVE_AUDIO=y
BR2_PACKAGE_LIBCURL=y
BR2_PACKAGE_LIBEVENT=y
BR2_PACKAGE_ORC=y
BR2_PACKAGE_PROTOBUF=y
BR2_PACKAGE_SHARED_MIME_INFO=y
BR2_PACKAGE_DROPBEAR=y
BR2_PACKAGE_GESFTPSERVER=y
BR2_PACKAGE_LIGHTTPD=y
BR2_PACKAGE_OPENSSH=y
BR2_PACKAGE_WPA_SUPPLICANT=y
BR2_PACKAGE_WPA_SUPPLICANT_AP_SUPPORT=y
BR2_PACKAGE_WPA_SUPPLICANT_AUTOSCAN=y
BR2_PACKAGE_WPA_SUPPLICANT_EAP=y
BR2_PACKAGE_WPA_SUPPLICANT_HOTSPOT=y
BR2_PACKAGE_WPA_SUPPLICANT_WPS=y
BR2_PACKAGE_WPEWEBKIT_USE_GSTREAMER_WEBRTC=y
BR2_PACKAGE_WPEWEBKIT_USE_GSTREAMER_FULL=y
```

## package/gstreamer1/gstreamer1-full/Config.in
```kconfig
comment "gstreamer-full 1.x needs a toolchain w/ wchar, threads"
	depends on BR2_USE_MMU
	depends on !BR2_USE_WCHAR || !BR2_TOOLCHAIN_HAS_THREADS

config BR2_PACKAGE_GSTREAMER1_FULL
	bool "gstreamer-full 1.x"
	depends on BR2_USE_WCHAR # glib2
	depends on BR2_TOOLCHAIN_HAS_THREADS # glib2
	depends on BR2_USE_MMU # glib2
	select BR2_PACKAGE_LIBGLIB2
	select BR2_PACKAGE_OPENSSL
	select BR2_PACKAGE_LIBOPENSSL
	select BR2_PACKAGE_LIBXML2
	select BR2_PACKAGE_FAAD2
	select BR2_PACKAGE_WEBP
	select BR2_PACKAGE_WEBP_MUX
	help
	  GStreamer is an open source multimedia framework. This 1.x
	  version of Gstreamer is incompatible with Gstreamer 0.10.x.

	  gstreamer-full compiles everything into a single library.

	  http://gstreamer.freedesktop.org/

if BR2_PACKAGE_GSTREAMER1_FULL

config BR2_PACKAGE_GST1_FULL_PLUGINS_BASE_LIB_OPENGL_GLES2
	bool "gles2"
	default y
	depends on BR2_PACKAGE_HAS_LIBGLES

comment "gles2 needs an OpenGL ES backend"
	depends on !BR2_PACKAGE_HAS_LIBGLES

config BR2_PACKAGE_GST1_FULL_PLUGINS_BAD_PLUGIN_WEBRTC
	bool "webrtc"
	select BR2_PACKAGE_LIBSRTP
	help
	  WebRTC plugins (webrtcbin - a bin for webrtc connections)

config BR2_PACKAGE_GSTREAMER1_FULL_SYMBOLS
	bool "build with symbols"
	default n
	help
	  Compiles some GStreamer related packages with symbols. For now only gstreamer, gst-plugins-base, -good, -bad, -ugly and gst-omx are honoring this.

if BR2_PACKAGE_GSTREAMER1_FULL_SYMBOLS

config BR2_PACKAGE_GSTREAMER1_FULL_NO_OPTIMIZATIONS
	bool "build with no optimizations"
	default y
	help
	  Compiles some GStreamer related packages with no optimizations

endif

endif
```

## package/opentelemetry-cpp/Config.in
```kconfig
config BR2_PACKAGE_OPENTELEMETRY_CPP
	bool "opentelemetry-cpp"
	depends on BR2_INSTALL_LIBSTDCPP
	depends on BR2_TOOLCHAIN_HAS_THREADS
	depends on BR2_TOOLCHAIN_GCC_AT_LEAST_8 # protobuf, libabseil-cpp
	depends on !BR2_STATIC_LIBS
	help
	  OpenTelemetry C++ API and SDK (traces, metrics and logs).

	  https://github.com/open-telemetry/opentelemetry-cpp

if BR2_PACKAGE_OPENTELEMETRY_CPP

config BR2_PACKAGE_OPENTELEMETRY_CPP_OTLP_HTTP
	bool "OTLP HTTP exporter"
	depends on BR2_PACKAGE_PROTOBUF_ARCH_SUPPORTS
	select BR2_PACKAGE_JSON_FOR_MODERN_CPP
	select BR2_PACKAGE_LIBCURL
	select BR2_PACKAGE_PROTOBUF
	help
	  Export telemetry over OTLP/HTTP (uses libcurl).

config BR2_PACKAGE_OPENTELEMETRY_CPP_OTLP_HTTP_COMPRESSION
	bool "gzip compression for OTLP HTTP"
	depends on BR2_PACKAGE_OPENTELEMETRY_CPP_OTLP_HTTP
	select BR2_PACKAGE_ZLIB
	help
	  Allow gzip compression of OTLP/HTTP requests.

config BR2_PACKAGE_OPENTELEMETRY_CPP_OTLP_FILE
	bool "OTLP file exporter"
	depends on BR2_PACKAGE_PROTOBUF_ARCH_SUPPORTS
	select BR2_PACKAGE_JSON_FOR_MODERN_CPP
	select BR2_PACKAGE_PROTOBUF
	help
	  Write telemetry as OTLP JSON to files.

config BR2_PACKAGE_OPENTELEMETRY_CPP_ZIPKIN
	bool "Zipkin exporter"
	select BR2_PACKAGE_JSON_FOR_MODERN_CPP
	select BR2_PACKAGE_LIBCURL
	help
	  Export traces to Zipkin (uses libcurl).

config BR2_PACKAGE_OPENTELEMETRY_CPP_ELASTICSEARCH
	bool "Elasticsearch exporter"
	select BR2_PACKAGE_JSON_FOR_MODERN_CPP
	select BR2_PACKAGE_LIBCURL
	help
	  Export logs to Elasticsearch (uses libcurl).

endif

comment "opentelemetry-cpp needs a toolchain w/ C++, threads, dynamic library, gcc >= 8"
	depends on !BR2_INSTALL_LIBSTDCPP || !BR2_TOOLCHAIN_HAS_THREADS \
		|| !BR2_TOOLCHAIN_GCC_AT_LEAST_8 || BR2_STATIC_LIBS
```

## package/westeros-sink/Config.in
```kconfig
config BR2_PACKAGE_WESTEROS_SINK
	bool "westeros-sink"
	select BR2_PACKAGE_WAYLAND
	select BR2_PACKAGE_WAYLAND_PROTOCOLS
	select BR2_PACKAGE_WAYLAND_EGL_BNXS if BR2_PACKAGE_HAS_NEXUS
	select BR2_PACKAGE_GSTREAMER1
	select BR2_PACKAGE_GST1_PLUGINS_BASE
	help
	  http://wayland.freedesktop.org/
```
