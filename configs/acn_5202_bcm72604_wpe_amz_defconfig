## configs/acn_5202_bcm72604_wpe_amz_defconfig
```kconfig
BR2_arm=y
BR2_cortex_a7=y
BR2_ARM_FPU_VFPV3D16=y
BR2_CCACHE=y
BR2_OPTIMIZE_2=y
BR2_TOOLCHAIN_EXTERNAL=y
BR2_TOOLCHAIN_EXTERNAL_CUSTOM=y
BR2_TOOLCHAIN_EXTERNAL_PATH="/src/kpn/toolchain/acn-5202"
BR2_TOOLCHAIN_EXTERNAL_CUSTOM_PREFIX="arm-unknown-linux-gnueabihf"
BR2_TOOLCHAIN_EXTERNAL_GCC_6=y
BR2_TOOLCHAIN_EXTERNAL_HEADERS_4_9=y
BR2_TOOLCHAIN_EXTERNAL_CUSTOM_GLIBC=y
BR2_TOOLCHAIN_EXTERNAL_CXX=y
BR2_PACKAGE_HOST_GDB=y
BR2_TARGET_GENERIC_HOSTNAME="vip5202"
BR2_TARGET_GENERIC_ISSUE="Welcome to vip5202"
BR2_TARGET_GENERIC_CABUNDLE=y
# BR2_TARGET_GENERIC_NETWORK is not set
BR2_TARGET_GENERIC_ROOT_PASSWD="root"
BR2_TARGET_GENERIC_GETTY_PORT="ttyS0"
BR2_SYSTEM_DHCP="eth0"
BR2_ROOTFS_POST_BUILD_SCRIPT="board/acn-5202/post-build.sh"
BR2_ROOTFS_POST_IMAGE_SCRIPT="board/acn-5202/acn-5202.sh"
BR2_PACKAGE_BUSYBOX_SMP=y
BR2_PACKAGE_LIBAMAZON=y
BR2_PACKAGE_GSTREAMER1=y
BR2_PACKAGE_GST1_BCM=y
# BR2_PACKAGE_GST1_BCM_UNIFIED_VERSION is not set
BR2_PACKAGE_GST1_BCM_ENABLE_SVP=y
BR2_PACKAGE_GST1_PLUGINS_BASE_PLUGIN_APP=y
BR2_PACKAGE_GST1_PLUGINS_BASE_PLUGIN_VIDEOCONVERT=y
BR2_PACKAGE_GST1_PLUGINS_BASE_PLUGIN_GIO=y
BR2_PACKAGE_GST1_PLUGINS_BASE_PLUGIN_OPUS=y
BR2_PACKAGE_GST1_PLUGINS_GOOD_PLUGIN_AUDIOFX=y
BR2_PACKAGE_GST1_PLUGINS_GOOD_PLUGIN_AUDIOPARSERS=y
BR2_PACKAGE_GST1_PLUGINS_GOOD_PLUGIN_AUTODETECT=y
BR2_PACKAGE_GST1_PLUGINS_GOOD_PLUGIN_DEINTERLACE=y
BR2_PACKAGE_GST1_PLUGINS_GOOD_PLUGIN_ICYDEMUX=y
BR2_PACKAGE_GST1_PLUGINS_GOOD_PLUGIN_ID3DEMUX=y
BR2_PACKAGE_GST1_PLUGINS_GOOD_PLUGIN_INTERLEAVE=y
BR2_PACKAGE_GST1_PLUGINS_GOOD_PLUGIN_MATROSKA=y
BR2_PACKAGE_GST1_PLUGINS_GOOD_PLUGIN_SOUPHTTPSRC=y
BR2_PACKAGE_GST1_PLUGINS_BAD_PLUGIN_MPEGTSDEMUX=y
BR2_PACKAGE_GST1_PLUGINS_BAD_PLUGIN_VIDEOPARSERS=y
BR2_PACKAGE_GST1_PLUGINS_BAD_PLUGIN_DASH=y
BR2_PACKAGE_GST1_PLUGINS_BAD_PLUGIN_FAAD=y
BR2_PACKAGE_GST1_PLUGINS_BAD_PLUGIN_HLS=y
BR2_PACKAGE_GST1_PLUGINS_BAD_PLUGIN_OPUS=y
BR2_PACKAGE_GST1_PLUGINS_BAD_PLUGIN_SMOOTHSTREAMING=y
BR2_PACKAGE_GST1_PLUGINS_UGLY=y
BR2_PACKAGE_GST1_PLUGINS_UGLY_PLUGIN_MPG123=y
BR2_PACKAGE_NINJA=y
BR2_PACKAGE_BITSTREAM_VERA=y
BR2_PACKAGE_ACN_5202_SDK=y
BR2_PACKAGE_TREMOR=y
BR2_PACKAGE_OPENSSL=y
BR2_PACKAGE_GRAPHITE2=y
BR2_PACKAGE_LIBMNG=y
BR2_PACKAGE_WEBP=y
BR2_PACKAGE_WPEFRAMEWORK_PORT="8081"
BR2_PACKAGE_WPEFRAMEWORK_PERSISTENT_PATH="/etc/nsn/persistent"
BR2_PACKAGE_WPEFRAMEWORK_DATA_PATH="/usr/share/WPEFramework"
BR2_PACKAGE_WPEFRAMEWORK_SYSTEM_PATH="/usr/lib/wpeframework/plugins"
BR2_PACKAGE_WPEFRAMEWORK_PROXYSTUB_PATH="/usr/lib/wpeframework/proxystubs"
BR2_PACKAGE_WPEFRAMEWORK_GSTREAMERCLIENT=y
BR2_PACKAGE_WPEFRAMEWORK_CDMI_PLAYREADY_NEXUS_SVP=y
# BR2_PACKAGE_WPEFRAMEWORK_CDMI_WIDEVINE_NEXUS_SVP is not set
BR2_PACKAGE_WPEFRAMEWORK_COMPOSITOR=y
BR2_PACKAGE_WPEFRAMEWORK_COMPOSITOR_OUTOFPROCESS=y
BR2_PACKAGE_WPEFRAMEWORK_COMPOSITOR_RESOLUTION_2160P=y
BR2_PACKAGE_WPEFRAMEWORK_COMPOSITOR_NEXUS_SERVER_EXTERNAL=y
# BR2_PACKAGE_WPEFRAMEWORK_DEVICEIDENTIFICATION is not set
# BR2_PACKAGE_WPEFRAMEWORK_DISPLAYINFO is not set
# BR2_PACKAGE_WPEFRAMEWORK_PLAYERINFO is not set
BR2_PACKAGE_WPEFRAMEWORK_REMOTECONTROL=y
BR2_PACKAGE_WPEFRAMEWORK_TIMESYNC=y
BR2_PACKAGE_WPEFRAMEWORK_TRACECONTROL=y
BR2_PACKAGE_WPEFRAMEWORK_WEBKITBROWSER=y
BR2_PACKAGE_WPEFRAMEWORK_WEBKITBROWSER_AMAZON_HAWAII=y
# BR2_PACKAGE_WPEFRAMEWORK_WEBKITBROWSER_AUTOSTART is not set
BR2_PACKAGE_WPEFRAMEWORK_WEBKITBROWSER_STARTURL="http://www.youtube.com/tv"
BR2_PACKAGE_WPEFRAMEWORK_WEBKITBROWSER_MEMORYPROFILE="512m"
BR2_PACKAGE_WPEFRAMEWORK_WEBKITBROWSER_MEMORYPRESSURE="databaseprocess:50m,networkprocess:100m,webprocess:512m,rpcprocess:50m"
BR2_PACKAGE_WPEFRAMEWORK_WEBKITBROWSER_TRANSPARENT=y
BR2_PACKAGE_WPEFRAMEWORK_AMAZON_TAB=y
BR2_PACKAGE_WPEFRAMEWORK_AMAZON_TRANSPARENT=y
BR2_PACKAGE_WPEFRAMEWORK_AMAZON_USER="utc"
BR2_PACKAGE_WPEFRAMEWORK_AMAZON_GROUP="utc"
BR2_PACKAGE_WPEWEBKIT=y
BR2_PACKAGE_WPEWEBKIT_ENABLE_NATIVE_AUDIO=y
BR2_PACKAGE_C_ARES=y
BR2_PACKAGE_NGHTTP2=y
BR2_PACKAGE_ORC=y
BR2_PACKAGE_ICU_USE_ICUDATA=y
BR2_PACKAGE_DROPBEAR=y
```

## configs/explora_bcm7267_wpe_ml_defconfig
```kconfig
BR2_arm=y
BR2_cortex_a15=y
BR2_ARM_FPU_NEON_VFPV4=y
BR2_ARM_INSTRUCTIONS_THUMB2=y
BR2_CCACHE=y
BR2_OPTIMIZE_2=y
BR2_TOOLCHAIN_BUILDROOT_GLIBC=y
BR2_KERNEL_HEADERS_4_9=y
BR2_BINUTILS_VERSION_2_27_X=y
BR2_GCC_VERSION_6_X=y
BR2_TOOLCHAIN_BUILDROOT_CXX=y
BR2_GCC_ENABLE_LTO=y
BR2_PACKAGE_HOST_GDB=y
BR2_TARGET_GENERIC_CABUNDLE=y
# BR2_TARGET_GENERIC_NETWORK is not set
BR2_ROOTFS_DEVICE_CREATION_DYNAMIC_EUDEV=y
BR2_TARGET_GENERIC_ROOT_PASSWD="root"
BR2_TARGET_GENERIC_GETTY_PORT="ttyS0"
BR2_SYSTEM_DHCP="eth0"
BR2_ROOTFS_POST_BUILD_SCRIPT="board/explora/post-build.sh"
BR2_ROOTFS_POST_IMAGE_SCRIPT="board/explora/explora.sh"
BR2_PACKAGE_BUSYBOX_SMP=y
BR2_PACKAGE_AMAZON=y
BR2_PACKAGE_AMAZON_PLATFORM_FAMILY_NAME="wpeframework"
BR2_PACKAGE_AMAZON_PLATFORM_NAME="generic"
BR2_PACKAGE_AMAZON_TAG="1.3.2"
BR2_PACKAGE_AMAZON_IG_READ_WRITE_PATH="/UserApps/amazon_video"
BR2_PACKAGE_AMAZON_DTID="A3FOC3OBMPMK91"
BR2_PACKAGE_AMAZON_BACKEND=y
BR2_PACKAGE_AMAZON_IGNITION=y
BR2_PACKAGE_COBALT_BUILD_TYPE_GOLD=y
BR2_PACKAGE_GSTREAMER1=y
BR2_PACKAGE_GST1_BCM=y
BR2_PACKAGE_GST1_BCM_ENABLE_SVP=y
BR2_PACKAGE_GST1_PLUGINS_BASE_PLUGIN_APP=y
BR2_PACKAGE_GST1_PLUGINS_BASE_PLUGIN_VIDEOCONVERT=y
BR2_PACKAGE_GST1_PLUGINS_BASE_PLUGIN_GIO=y
BR2_PACKAGE_GST1_PLUGINS_BASE_PLUGIN_OGG=y
BR2_PACKAGE_GST1_PLUGINS_BASE_PLUGIN_OPUS=y
BR2_PACKAGE_GST1_PLUGINS_GOOD_PLUGIN_AUDIOFX=y
BR2_PACKAGE_GST1_PLUGINS_GOOD_PLUGIN_AUDIOPARSERS=y
BR2_PACKAGE_GST1_PLUGINS_GOOD_PLUGIN_AUTODETECT=y
BR2_PACKAGE_GST1_PLUGINS_GOOD_PLUGIN_DEINTERLACE=y
BR2_PACKAGE_GST1_PLUGINS_GOOD_PLUGIN_ICYDEMUX=y
BR2_PACKAGE_GST1_PLUGINS_GOOD_PLUGIN_ID3DEMUX=y
BR2_PACKAGE_GST1_PLUGINS_GOOD_PLUGIN_INTERLEAVE=y
BR2_PACKAGE_GST1_PLUGINS_GOOD_PLUGIN_MATROSKA=y
BR2_PACKAGE_GST1_PLUGINS_GOOD_PLUGIN_SOUPHTTPSRC=y
BR2_PACKAGE_GST1_PLUGINS_BAD_PLUGIN_MPEGTSDEMUX=y
BR2_PACKAGE_GST1_PLUGINS_BAD_PLUGIN_VIDEOPARSERS=y
BR2_PACKAGE_GST1_PLUGINS_BAD_PLUGIN_DASH=y
BR2_PACKAGE_GST1_PLUGINS_BAD_PLUGIN_FAAD=y
BR2_PACKAGE_GST1_PLUGINS_BAD_PLUGIN_HLS=y
BR2_PACKAGE_GST1_PLUGINS_BAD_PLUGIN_OPUS=y
BR2_PACKAGE_GST1_PLUGINS_BAD_PLUGIN_SMOOTHSTREAMING=y
BR2_PACKAGE_GST1_PLUGINS_UGLY=y
BR2_PACKAGE_GST1_PLUGINS_UGLY_PLUGIN_MPG123=y
BR2_PACKAGE_NETFLIX52=y
BR2_PACKAGE_NINJA=y
BR2_PACKAGE_BITSTREAM_VERA=y
BR2_PACKAGE_EXPLORA_SDK=y
BR2_PACKAGE_WPEFRAMEWORK_PORT="2300"
BR2_PACKAGE_WPEFRAMEWORK_DATA_PATH="/UserApps/metrological/usr/share/WPEFramework"
BR2_PACKAGE_WPEFRAMEWORK_SYSTEM_PATH="/UserApps/metrological/usr/lib/wpeframework/plugins"
BR2_PACKAGE_WPEFRAMEWORK_PROXYSTUB_PATH="/UserApps/metrological/usr/lib/wpeframework/proxystubs"
BR2_PACKAGE_WPEFRAMEWORK_SYSTEM_PREFIX="MCA"
BR2_PACKAGE_WPEFRAMEWORK_CRYPTOGRAPHY=y
BR2_PACKAGE_WPEFRAMEWORK_CRYPTOGRAPHY_IMPLEMENTATION_NEXUS=y
# BR2_PACKAGE_WPEFRAMEWORK_CDMI_SOFTWARE_OVERRIDE is not set
BR2_PACKAGE_WPEFRAMEWORK_CDMI_PLAYREADY_SECURE_STOP_METERING_CERTIFICATE="/UserApps/metrological/root/Netflix/artifacts/MeteringCertificate.bin"
BR2_PACKAGE_BCM_REFSW_SAGE_WIDEVINE_VERSION_16=y
BR2_PACKAGE_WPEFRAMEWORK_CDMI_WIDEVINE_DEVICE_CERTIFICATE="/UserApps/metrological/root/OCDM/Widevine/cert.bin"
BR2_PACKAGE_WPEFRAMEWORK_CDMI_WIDEVINE_PRODUCT_NAME="Explora Ultra"
BR2_PACKAGE_WPEFRAMEWORK_CDMI_WIDEVINE_COMPANY_NAME="DStv-Explora"
BR2_PACKAGE_WPEFRAMEWORK_CDMI_WIDEVINE_MODEL_NAME="Ultra"
BR2_PACKAGE_WPEFRAMEWORK_CDMI_WIDEVINE_DEVICE_NAME="Linux"
BR2_PACKAGE_WPEFRAMEWORK_COBALT=y
BR2_PACKAGE_WPEFRAMEWORK_COBALT_RESOLUTION_1080P=y
BR2_PACKAGE_WPEFRAMEWORK_COBALT_SINGLE_PLAYBACKRATE=y
BR2_PACKAGE_WPEFRAMEWORK_COBALT_AUTOSTART=y
BR2_PACKAGE_WPEFRAMEWORK_COBALT_MANUFACTURER_NAME="Commscope"
BR2_PACKAGE_WPEFRAMEWORK_COBALT_CHIPSET_MODEL_NUMBER="BCM7267"
BR2_PACKAGE_WPEFRAMEWORK_COBALT_FIRMWARE_VERSION="1.2"
BR2_PACKAGE_WPEFRAMEWORK_COBALT_MODEL_NAME="Ultra"
BR2_PACKAGE_WPEFRAMEWORK_COBALT_MODEL_YEAR="2020"
BR2_PACKAGE_WPEFRAMEWORK_COBALT_OPERATOR_NAME="DStv-Explora"
BR2_PACKAGE_WPEFRAMEWORK_COBALT_FRIENDLY_NAME="Thunder"
BR2_PACKAGE_WPEFRAMEWORK_COMPOSITOR=y
BR2_PACKAGE_WPEFRAMEWORK_COMPOSITOR_OUTOFPROCESS=y
BR2_PACKAGE_WPEFRAMEWORK_COMPOSITOR_RESOLUTION_1080P=y
BR2_PACKAGE_WPEFRAMEWORK_COMPOSITOR_NEXUS_SERVER_EXTERNAL=y
# BR2_PACKAGE_WPEFRAMEWORK_DEVICEIDENTIFICATION is not set
BR2_PACKAGE_WPEFRAMEWORK_DIALSERVER=y
BR2_PACKAGE_WPEFRAMEWORK_DIALSERVER_NAME="ExploraUltra"
BR2_PACKAGE_WPEFRAMEWORK_DIALSERVER_YOUTUBE_MODE_ACTIVE=y
BR2_PACKAGE_WPEFRAMEWORK_DIALSERVER_NETFLIX_MODE_ACTIVE=y
BR2_PACKAGE_WPEFRAMEWORK_DIALSERVER_AMAZON_PRIME_MODE_ACTIVE=y
BR2_PACKAGE_WPEFRAMEWORK_INPUTSWITCH=y
BR2_PACKAGE_WPEFRAMEWORK_LOCATIONSYNC=y
BR2_PACKAGE_WPEFRAMEWORK_LOCATIONSYNC_URI="http://jsonip.metrological.com/?maf=true"
BR2_PACKAGE_WPEFRAMEWORK_PLAYERINFO_DOLBY_SUPPORT=y
BR2_PACKAGE_WPEFRAMEWORK_REMOTECONTROL=y
BR2_PACKAGE_WPEFRAMEWORK_TIMESYNC=y
BR2_PACKAGE_WPEFRAMEWORK_TRACECONTROL=y
BR2_PACKAGE_WPEFRAMEWORK_VOLUMECONTROL=y
BR2_PACKAGE_WPEFRAMEWORK_WEBKITBROWSER=y
BR2_PACKAGE_WPEFRAMEWORK_WEBKITBROWSER_USERAGENT="Mozilla/5.0 (DStv Explora Ultra, PS5525IMC) AppleWebKit/602.1.28+ (KHTML, like Gecko) Version/9.1 Safari/601.5.17"
BR2_PACKAGE_WPEFRAMEWORK_WEBKITBROWSER_MEMORYPROFILE="512m"
BR2_PACKAGE_WPEFRAMEWORK_WEBKITBROWSER_MEMORYPRESSURE="databaseprocess:100m,networkprocess:300m,webprocess:512m,rpcprocess:50m"
BR2_PACKAGE_WPEFRAMEWORK_WEBKITBROWSER_TRANSPARENT=y
BR2_PACKAGE_WPEFRAMEWORK_WEBKITBROWSER_MSEBUFFERS="audio:12m,video:65m,text:1m"
BR2_PACKAGE_WPEFRAMEWORK_WEBKITBROWSER_INSPECTOR="0.0.0.0:9998"
BR2_PACKAGE_WPEFRAMEWORK_AMAZON_MANUFACTURER="Commscope"
BR2_PACKAGE_WPEFRAMEWORK_AMAZON_FRAGMENT_CACHE_SIZE="100"
BR2_PACKAGE_WPEFRAMEWORK_AMAZON_USER="amazon"
BR2_PACKAGE_WPEFRAMEWORK_AMAZON_GROUP="amazon"
BR2_PACKAGE_WPEFRAMEWORK_UX=y
BR2_PACKAGE_WPEFRAMEWORK_WEBSERVER=y
BR2_PACKAGE_WPEFRAMEWORK_WEBSERVER_PORT="80"
BR2_PACKAGE_WPEFRAMEWORK_AMAZON=y
BR2_PACKAGE_WPEFRAMEWORK_AMAZON_DTID="A1I8SDQ4F0D8V0"
BR2_PACKAGE_WPEFRAMEWORK_AMAZON_MODEL="Explora Ultra"
BR2_PACKAGE_WPEFRAMEWORK_AMAZON_CHIPSET="BCM7267"
BR2_PACKAGE_WPEFRAMEWORK_AMAZON_CA_BUNDLE_PATH="/UserApps/metrological/etc/ssl/certs/"
BR2_PACKAGE_WPEFRAMEWORK_AMAZON_AUTOSTART=y
BR2_PACKAGE_WPEFRAMEWORK_AMAZON_INSTALL_PATH_OVERRIDE="/UserApps/metrological/usr/share/ignition/"
BR2_PACKAGE_WPEFRAMEWORK_NETFLIX=y
BR2_PACKAGE_WPEFRAMEWORK_PLUGIN_NETFLIX_AUTOSTART=y
BR2_PACKAGE_WPEFRAMEWORK_PLUGIN_NETFLIX_MODEL="Multichoice_Explora Ultra Model"
BR2_PACKAGE_WPEFRAMEWORK_PLUGIN_NETFLIX_FRIENDLY_NAME="ExploraUltra"
BR2_PACKAGE_WPEFRAMEWORK_PLUGIN_NETFLIX_VERSION="5.2.3"
BR2_PACKAGE_WPEFRAMEWORK_PLUGIN_NETFLIX_VERSION_POSTFIX="1.0.5"
BR2_PACKAGE_WPEFRAMEWORK_PLUGIN_NETFLIX_SURFACE_CACHE_SIZE="58720256"
BR2_PACKAGE_WPEFRAMEWORK_PLUGIN_NETFLIX_JAVASCRIPT_SIZE="247463936"
BR2_PACKAGE_WPEFRAMEWORK_PLUGIN_NETFLIX_HDR10=y
BR2_PACKAGE_WPEFRAMEWORK_PLUGIN_NETFLIX_HEVC=y
BR2_PACKAGE_WPEFRAMEWORK_PLUGIN_NETFLIX_VP9_P2=y
BR2_PACKAGE_WPEFRAMEWORK_PLUGIN_NETFLIX_VP9_HDR=y
BR2_PACKAGE_WPEFRAMEWORK_PLUGIN_NETFLIX_DEFAULT_LAUGUAGE="en-ZA"
BR2_PACKAGE_WPEFRAMEWORK_PLUGIN_NETFLIX_DEVICE_KEYS="/tmp/netflix.bin"
BR2_PACKAGE_WPEFRAMEWORK_PLUGIN_NETFLIX_IID_BG_LAUNCH="ee4255bf"
BR2_PACKAGE_WPEFRAMEWORK_PLUGIN_NETFLIX_IID_BG_RESTART="161ef87b"
BR2_PACKAGE_WPEFRAMEWORK_PLUGIN_NETFLIX_IID_FG_RESTART="35e297d3"
BR2_PACKAGE_WPEFRAMEWORK_PROVISIONING=y
BR2_PACKAGE_WPEFRAMEWORK_PROVISIONING_URI=""
BR2_PACKAGE_WPEFRAMEWORK_PROVISIONING_OPERATOR="local"
BR2_PACKAGE_WPEWEBKIT=y
BR2_PACKAGE_WPEWEBKIT_ALTERNATIVE_EXEC_PATH="/UserApps/metrological/usr/bin"
BR2_PACKAGE_ORC=y
BR2_PACKAGE_ICU_USE_ICUDATA=y
BR2_PACKAGE_SHARED_MIME_INFO=y
BR2_PACKAGE_DROPBEAR=y
BR2_PACKAGE_GESFTPSERVER=y
BR2_PACKAGE_WPA_SUPPLICANT=y
BR2_PACKAGE_WPA_SUPPLICANT_AP_SUPPORT=y
BR2_PACKAGE_WPA_SUPPLICANT_AUTOSCAN=y
BR2_PACKAGE_WPA_SUPPLICANT_EAP=y
BR2_PACKAGE_WPA_SUPPLICANT_HOTSPOT=y
BR2_PACKAGE_WPA_SUPPLICANT_WPS=y
BR2_PACKAGE_HOST_MKE2IMG=y
```

## configs/raspberrypi3_wpe_2_42_cog_defconfig
```kconfig
BR2_arm=y
BR2_cortex_a53=y
BR2_ARM_FPU_NEON_VFPV4=y
BR2_ARM_INSTRUCTIONS_THUMB2=y
BR2_CCACHE=y
BR2_OPTIMIZE_2=y
BR2_TOOLCHAIN_BUILDROOT_GLIBC=y
BR2_BINUTILS_VERSION_2_33_X=y
BR2_GCC_VERSION_10_X=y
BR2_TOOLCHAIN_BUILDROOT_CXX=y
BR2_SYSTEM_DHCP="eth0"
BR2_ROOTFS_DEVICE_CREATION_DYNAMIC_EUDEV=y
BR2_TARGET_GENERIC_ROOT_PASSWD="root"
BR2_ROOTFS_POST_BUILD_SCRIPT="board/raspberrypi3/post-build.sh"
BR2_ROOTFS_POST_IMAGE_SCRIPT="board/raspberrypi3/post-image.sh"
BR2_ROOTFS_POST_SCRIPT_ARGS="--rpi-wifi --overclock-pi3 --tvmode-720 --gpu_mem_1024=384 --silent --1w --i2c --spi --add-miniuart-bt-overlay"
BR2_LINUX_KERNEL=y
BR2_LINUX_KERNEL_CUSTOM_GIT=y
BR2_LINUX_KERNEL_CUSTOM_REPO_URL="https://github.com/raspberrypi/linux"
BR2_LINUX_KERNEL_CUSTOM_REPO_VERSION="rpi-5.15.y"
BR2_LINUX_KERNEL_USE_CUSTOM_CONFIG=y
BR2_LINUX_KERNEL_CUSTOM_CONFIG_FILE="board/raspberrypi/rpi34-linux-5.15.config"
BR2_LINUX_KERNEL_LZ4=y
BR2_LINUX_KERNEL_DTS_SUPPORT=y
BR2_LINUX_KERNEL_INTREE_DTS_NAME="bcm2710-rpi-3-b bcm2710-rpi-3-b-plus bcm2710-rpi-cm3"
BR2_LINUX_KERNEL_NEEDS_HOST_OPENSSL=y
BR2_PACKAGE_BUSYBOX_SHOW_OTHERS=y
BR2_PACKAGE_IFUPDOWN=y
BR2_PACKAGE_NTP=y
BR2_PACKAGE_GSTREAMER1_18=y
BR2_PACKAGE_GST1_PLUGINS_BASE_PLUGIN_APP=y
BR2_PACKAGE_GST1_PLUGINS_BASE_PLUGIN_VIDEOCONVERT=y
BR2_PACKAGE_GST1_PLUGINS_BASE_PLUGIN_GIO=y
BR2_PACKAGE_GST1_PLUGINS_BASE_LIB_OPENGL=y
BR2_PACKAGE_GST1_PLUGINS_BASE_PLUGIN_ALSA=y
BR2_PACKAGE_GST1_PLUGINS_BASE_PLUGIN_OPUS=y
BR2_PACKAGE_GST1_PLUGINS_GOOD_PLUGIN_AUDIOFX=y
BR2_PACKAGE_GST1_PLUGINS_GOOD_PLUGIN_AUDIOPARSERS=y
BR2_PACKAGE_GST1_PLUGINS_GOOD_PLUGIN_AUTODETECT=y
BR2_PACKAGE_GST1_PLUGINS_GOOD_PLUGIN_DEINTERLACE=y
BR2_PACKAGE_GST1_PLUGINS_GOOD_PLUGIN_ICYDEMUX=y
BR2_PACKAGE_GST1_PLUGINS_GOOD_PLUGIN_ID3DEMUX=y
BR2_PACKAGE_GST1_PLUGINS_GOOD_PLUGIN_INTERLEAVE=y
BR2_PACKAGE_GST1_PLUGINS_GOOD_PLUGIN_MATROSKA=y
BR2_PACKAGE_GST1_PLUGINS_GOOD_PLUGIN_MPG123=y
BR2_PACKAGE_GST1_PLUGINS_BAD_PLUGIN_DEBUGUTILS=y
BR2_PACKAGE_GST1_PLUGINS_BAD_PLUGIN_MPEGTSDEMUX=y
BR2_PACKAGE_GST1_PLUGINS_BAD_PLUGIN_SUBENC=y
BR2_PACKAGE_GST1_PLUGINS_BAD_PLUGIN_VIDEOPARSERS=y
BR2_PACKAGE_GST1_PLUGINS_BAD_PLUGIN_DASH=y
BR2_PACKAGE_GST1_PLUGINS_BAD_PLUGIN_FAAD=y
BR2_PACKAGE_GST1_PLUGINS_BAD_PLUGIN_FDK_AAC=y
BR2_PACKAGE_GST1_PLUGINS_BAD_PLUGIN_HLS=y
BR2_PACKAGE_GST1_PLUGINS_BAD_PLUGIN_OPUS=y
BR2_PACKAGE_GST_OMX=y
BR2_PACKAGE_BITSTREAM_VERA=y
BR2_PACKAGE_RPI_BT_FIRMWARE=y
BR2_PACKAGE_RPI_FIRMWARE=y
BR2_PACKAGE_RPI_FIRMWARE_INSTALL_VCDBG=y
BR2_PACKAGE_RPI_WIFI_FIRMWARE=y
BR2_PACKAGE_RNG_TOOLS=y
BR2_PACKAGE_CA_CERTIFICATES=y
BR2_PACKAGE_ORC=y
BR2_PACKAGE_SHARED_MIME_INFO=y
BR2_PACKAGE_DROPBEAR=y
BR2_PACKAGE_BROTLI=y
BR2_PACKAGE_COG=y
BR2_PACKAGE_COG_USE_SYSTEM_DBUS=y
BR2_PACKAGE_COG_AUTOSTART=y
BR2_PACKAGE_XKEYBOARD_CONFIG=y
BR2_PACKAGE_LIBMANETTE=y
BR2_PACKAGE_WPEWEBKIT2_42=y
BR2_PACKAGE_HOST_DOSFSTOOLS=y
BR2_PACKAGE_HOST_GENIMAGE=y
BR2_PACKAGE_HOST_MTOOLS=y
```
