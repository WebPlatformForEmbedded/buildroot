## configs/raspberrypi3_wpe_next_cog_vc4_defconfig
```kconfig
BR2_arm=y
BR2_cortex_a53=y
BR2_ARM_FPU_NEON_VFPV4=y
BR2_ARM_INSTRUCTIONS_THUMB2=y
BR2_CCACHE=y
BR2_OPTIMIZE_2=y
BR2_TOOLCHAIN_BUILDROOT_GLIBC=y
BR2_PACKAGE_HOST_LINUX_HEADERS_CUSTOM_5_15=y
BR2_BINUTILS_VERSION_2_33_X=y
BR2_GCC_VERSION_12_X=y
BR2_TOOLCHAIN_BUILDROOT_CXX=y
BR2_PACKAGE_HOST_GDB=y
BR2_ROOTFS_DEVICE_CREATION_DYNAMIC_EUDEV=y
BR2_TARGET_GENERIC_ROOT_PASSWD="root"
BR2_SYSTEM_DHCP="eth0"
BR2_ROOTFS_POST_BUILD_SCRIPT="board/raspberrypi3/post-build.sh"
BR2_ROOTFS_POST_IMAGE_SCRIPT="board/raspberrypi3/post-image.sh"
BR2_ROOTFS_POST_SCRIPT_ARGS="--rpi-wifi --overclock-pi3 --tvmode-720 --add-vc4-kms-v3d-overlay-pi3 --1w --i2c --spi --add-miniuart-bt-overlay"
BR2_LINUX_KERNEL=y
BR2_LINUX_KERNEL_CUSTOM_GIT=y
BR2_LINUX_KERNEL_CUSTOM_REPO_URL="https://github.com/raspberrypi/linux"
BR2_LINUX_KERNEL_CUSTOM_REPO_VERSION="rpi-5.15.y"
BR2_LINUX_KERNEL_USE_CUSTOM_CONFIG=y
BR2_LINUX_KERNEL_CUSTOM_CONFIG_FILE="board/raspberrypi/rpi34-linux-5.15.config"
BR2_LINUX_KERNEL_LZ4=y
BR2_LINUX_KERNEL_DTS_SUPPORT=y
BR2_LINUX_KERNEL_INTREE_DTS_NAME="bcm2710-rpi-3-b bcm2710-rpi-3-b-plus bcm2710-rpi-cm3"
BR2_LINUX_KERNEL_NEEDS_HOST_OPENSSL=y
BR2_PACKAGE_BUSYBOX_SHOW_OTHERS=y
BR2_PACKAGE_GST1_PLUGINS_BASE_PLUGIN_AUDIOTESTSRC=y
BR2_PACKAGE_GST1_PLUGINS_BASE_PLUGIN_GIO=y
BR2_PACKAGE_GST1_PLUGINS_BASE_PLUGIN_VIDEOTESTSRC=y
BR2_PACKAGE_GST1_PLUGINS_BASE_LIB_OPENGL=y
BR2_PACKAGE_GST1_PLUGINS_BASE_PLUGIN_OPUS=y
BR2_PACKAGE_GST1_PLUGINS_GOOD_PLUGIN_AUDIOPARSERS=y
BR2_PACKAGE_GST1_PLUGINS_GOOD_PLUGIN_DEINTERLACE=y
BR2_PACKAGE_GST1_PLUGINS_GOOD_PLUGIN_ICYDEMUX=y
BR2_PACKAGE_GST1_PLUGINS_GOOD_PLUGIN_ID3DEMUX=y
BR2_PACKAGE_GST1_PLUGINS_GOOD_PLUGIN_INTERLEAVE=y
BR2_PACKAGE_GST1_PLUGINS_GOOD_PLUGIN_MPG123=y
BR2_PACKAGE_GST1_PLUGINS_GOOD_PLUGIN_V4L2=y
BR2_PACKAGE_GST1_PLUGINS_GOOD_PLUGIN_V4L2_PROBE=y
BR2_PACKAGE_GST1_PLUGINS_BAD_PLUGIN_VIDEOPARSERS=y
BR2_PACKAGE_GST1_PLUGINS_BAD_PLUGIN_DASH=y
BR2_PACKAGE_GST1_PLUGINS_BAD_PLUGIN_FAAD=y
BR2_PACKAGE_GST1_PLUGINS_BAD_PLUGIN_FDK_AAC=y
BR2_PACKAGE_GST1_PLUGINS_BAD_PLUGIN_HLS=y
BR2_PACKAGE_GST1_PLUGINS_BAD_PLUGIN_KMS=y
BR2_PACKAGE_GST1_PLUGINS_BAD_PLUGIN_OPUS=y
# BR2_PACKAGE_GST1_PLUGINS_BAD_PLUGIN_WPE is not set
BR2_PACKAGE_BROTLI=y
BR2_PACKAGE_GDB=y
BR2_PACKAGE_BITSTREAM_VERA=y
BR2_PACKAGE_COG=y
BR2_PACKAGE_COG_AUTOSTART=y
BR2_PACKAGE_COG_PLATFORM_FDO=y
BR2_PACKAGE_COG_PLATFORM_DRM=y
BR2_PACKAGE_COG_USE_SYSTEM_DBUS=y
BR2_PACKAGE_KMSCUBE=y
BR2_PACKAGE_MESA3D=y
BR2_PACKAGE_MESA3D_GALLIUM_DRIVER_KMSRO=y
BR2_PACKAGE_MESA3D_GALLIUM_DRIVER_V3D=y
BR2_PACKAGE_MESA3D_GALLIUM_DRIVER_VC4=y
BR2_PACKAGE_MESA3D_OPENGL_ES=y
BR2_PACKAGE_WESTON=y
BR2_PACKAGE_WESTON_DEFAULT_DRM=y
BR2_PACKAGE_WESTON_DEMO_CLIENTS=y
BR2_PACKAGE_RPI_FIRMWARE=y
BR2_PACKAGE_RPI_WIFI_FIRMWARE=y
BR2_PACKAGE_LIBMANETTE=y
BR2_PACKAGE_RNG_TOOLS=y
BR2_PACKAGE_CA_CERTIFICATES=y
BR2_PACKAGE_WPEWEBKIT_NEXT=y
# BR2_PACKAGE_WPEWEBKIT_USE_LIBWEBRTC is not set
BR2_PACKAGE_WPEBACKEND_FDO=y
BR2_PACKAGE_ORC=y
BR2_PACKAGE_COLLECTD=y
BR2_PACKAGE_SHARED_MIME_INFO=y
BR2_PACKAGE_IFUPDOWN=y
BR2_PACKAGE_NTP=y
BR2_PACKAGE_OPENSSH=y
BR2_PACKAGE_RSYNC=y
BR2_TARGET_ROOTFS_EXT2=y
BR2_TARGET_ROOTFS_EXT2_SIZE="16G"
BR2_PACKAGE_HOST_DOSFSTOOLS=y
BR2_PACKAGE_HOST_GENIMAGE=y
BR2_PACKAGE_HOST_MTOOLS=y
```

## configs/sagemcomrdk_wpe_ml_defconfig
```kconfig
BR2_arm=y
BR2_cortex_a15=y
BR2_ARM_FPU_NEON_VFPV4=y
BR2_ARM_INSTRUCTIONS_THUMB2=y
BR2_CCACHE=y
BR2_OPTIMIZE_2=y
BR2_TOOLCHAIN_BUILDROOT_GLIBC=y
BR2_KERNEL_HEADERS_5_4=y
BR2_BINUTILS_VERSION_2_33_X=y
#BR2_GCC_VERSION_9_X=y
BR2_GCC_VERSION_10_X=y
BR2_TOOLCHAIN_BUILDROOT_CXX=y
BR2_PACKAGE_HOST_GDB=y
BR2_ROOTFS_DEVICE_CREATION_DYNAMIC_EUDEV=y
BR2_TARGET_GENERIC_ROOT_PASSWD="root"
BR2_TARGET_GENERIC_GETTY_PORT="ttyS0"
BR2_ROOTFS_POST_BUILD_SCRIPT="board/sagemcom/post-build.sh"
BR2_ROOTFS_POST_IMAGE_SCRIPT="board/sagemcom/sagemcom.sh"
BR2_LINUX_KERNEL=y
BR2_LINUX_KERNEL_CUSTOM_GIT=y
BR2_LINUX_KERNEL_CUSTOM_REPO_URL="git@github.com:Metrological/bcm-stblinux-5.git"
BR2_LINUX_KERNEL_CUSTOM_REPO_VERSION="0e8da3c816111633c43d5bab9dc2f3bdfc6f4ea1"
BR2_LINUX_KERNEL_DEFCONFIG="brcmstb"
BR2_LINUX_KERNEL_CONFIG_FRAGMENT_FILES="board/bcm/config-fragments/cgroups.cfg board/bcm/config-fragments/ipv6.cfg board/bcm/config-fragments/netfilter.cfg board/bcm/config-fragments/wpa-supplicant.cfg board/bcm/config-fragments/no-vdso.cfg board/bcm/config-fragments/bt.cfg"
BR2_PACKAGE_GSTREAMER1_18=y
BR2_PACKAGE_GST1_BCM=n
BR2_PACKAGE_GST1_BCM_ENABLE_SVP=y
BR2_PACKAGE_GST1_PLUGINS_BASE_PLUGIN_GIO=y
BR2_PACKAGE_GST1_PLUGINS_BASE_PLUGIN_OPUS=y
BR2_PACKAGE_GST1_PLUGINS_GOOD_PLUGIN_AUDIOPARSERS=y
BR2_PACKAGE_GST1_PLUGINS_GOOD_PLUGIN_DEINTERLACE=y
BR2_PACKAGE_GST1_PLUGINS_GOOD_PLUGIN_ICYDEMUX=y
BR2_PACKAGE_GST1_PLUGINS_GOOD_PLUGIN_ID3DEMUX=y
BR2_PACKAGE_GST1_PLUGINS_GOOD_PLUGIN_INTERLEAVE=y
BR2_PACKAGE_GST1_PLUGINS_BAD_PLUGIN_VIDEOFILTERS=y
BR2_PACKAGE_GST1_PLUGINS_BAD_PLUGIN_VIDEOPARSERS=y
BR2_PACKAGE_GST1_PLUGINS_BAD_PLUGIN_DASH=y
BR2_PACKAGE_GST1_PLUGINS_BAD_PLUGIN_FAAD=y
BR2_PACKAGE_GST1_PLUGINS_BAD_PLUGIN_HLS=y
BR2_PACKAGE_GST1_PLUGINS_BAD_PLUGIN_OPUS=y
BR2_PACKAGE_GST1_PLUGINS_BAD_PLUGIN_WEBP=y
BR2_PACKAGE_GDB=y
BR2_PACKAGE_BITSTREAM_VERA=y
BR2_PACKAGE_SDK_RDKVA_SAGEMCOM=y
BR2_PACKAGE_CA_CERTIFICATES=y
BR2_PACKAGE_WPEFRAMEWORK=y
BR2_PACKAGE_WPEFRAMEWORK_BUILD_TYPE_DEBUG=y
BR2_PACKAGE_WPEFRAMEWORK_PERSISTENT_PATH="/mnt/root"
BR2_PACKAGE_WPEFRAMEWORK_VOLATILE_PATH="/mnt/tmp"
BR2_PACKAGE_WPEFRAMEWORK_DATA_PATH="/mnt/usr/share/WPEFramework"
BR2_PACKAGE_WPEFRAMEWORK_SYSTEM_PATH="/mnt/usr/lib/wpeframework/plugins"
BR2_PACKAGE_WPEFRAMEWORK_PROXYSTUB_PATH="/mnt/usr/lib/wpeframework/proxystubs"
BR2_PACKAGE_WPEFRAMEWORK_MESSAGING=y
BR2_PACKAGE_WPEFRAMEWORK_DISABLE_LEGACY_CONFIG_GENERATOR=y
BR2_PACKAGE_WPEFRAMEWORK_CDMI=n
# BR2_PACKAGE_WPEFRAMEWORK_CDMI_SOFTWARE_OVERRIDE is not set
BR2_PACKAGE_WPEFRAMEWORK_CDMI_PLAYREADY_MODULE=y
BR2_PACKAGE_WPEFRAMEWORK_CDMI_WIDEVINE_MODULE=y
BR2_PACKAGE_WIDEVINE_VERSION_16=y
BR2_PACKAGE_WPEFRAMEWORK_CDMI_WIDEVINE_DEVICE_CERTIFICATE="/mnt/root/Provisioning/Widevine/cert.bin"
BR2_PACKAGE_WPEFRAMEWORK_COMPOSITOR=y
BR2_PACKAGE_WPEFRAMEWORK_COMPOSITOR_OUTOFPROCESS=y
BR2_PACKAGE_WPEFRAMEWORK_COMPOSITOR_NEXUS_SERVER_EXTERNAL=y
BR2_PACKAGE_WPEFRAMEWORK_MESSENGER=y
BR2_PACKAGE_WPEFRAMEWORK_MONITOR=y
BR2_PACKAGE_WPEFRAMEWORK_REMOTECONTROL=y
BR2_PACKAGE_WPEFRAMEWORK_REMOTECONTROL_DEVINPUT=y
BR2_PACKAGE_WPEFRAMEWORK_SNAPSHOT=y
BR2_PACKAGE_WPEFRAMEWORK_MESSAGECONTROL=y
BR2_PACKAGE_WPEFRAMEWORK_VOLUMECONTROL=y
BR2_PACKAGE_WPEFRAMEWORK_WEBKITBROWSER=n
BR2_PACKAGE_WPEFRAMEWORK_WEBKITBROWSER_STARTURL="https://apps.rdkcentral.com/rdk-apps/accelerator-home-ui/index.html"
BR2_PACKAGE_WPEFRAMEWORK_WEBKITBROWSER_MEMORYPRESSURE="databaseprocess:50m,networkprocess:80m,webprocess:250m,rpcprocess:80m"
BR2_PACKAGE_WPEFRAMEWORK_WEBKITBROWSER_DISKCACHE="512m"
BR2_PACKAGE_WPEFRAMEWORK_WEBKITBROWSER_XHRCACHE=y
BR2_PACKAGE_WPEFRAMEWORK_YOUTUBE=y
BR2_PACKAGE_WPEFRAMEWORK_UX=y
BR2_PACKAGE_WPEFRAMEWORK_WEBKITBROWSER_THREADEDPAINTING="2"
BR2_PACKAGE_WPEFRAMEWORK_WEBSERVER=y
BR2_PACKAGE_WPEFRAMEWORK_PROVISIONING=y
BR2_PACKAGE_WPEFRAMEWORK_PROVISIONING_WIDEVINE=y
BR2_PACKAGE_WPEWEBKIT=y
BR2_PACKAGE_WPEWEBKIT2_42=y
BR2_PACKAGE_WPEWEBKIT_ENABLE_NATIVE_AUDIO=y
BR2_PACKAGE_COG=y
BR2_PACKAGE_LIBCURL=y
BR2_PACKAGE_ORC=y
BR2_PACKAGE_PROTOBUF=y
BR2_PACKAGE_SHARED_MIME_INFO=y
BR2_PACKAGE_DROPBEAR=y
BR2_PACKAGE_GESFTPSERVER=y
BR2_PACKAGE_LIGHTTPD=y
BR2_PACKAGE_OPENSSH=y
BR2_PACKAGE_WPA_SUPPLICANT=y
BR2_PACKAGE_WPA_SUPPLICANT_AP_SUPPORT=y
BR2_PACKAGE_WPA_SUPPLICANT_AUTOSCAN=y
BR2_PACKAGE_WPA_SUPPLICANT_EAP=y
BR2_PACKAGE_WPA_SUPPLICANT_HOTSPOT=y
BR2_PACKAGE_WPA_SUPPLICANT_WPS=y
BR2_PACKAGE_RDKSPLASHSCREEN=n
BR2_PACKAGE_RDKSPLASHSCREEN_OPERATOR="metrological"
```

## package/disney/Config.in
```kconfig
config BR2_PACKAGE_DISNEY
    bool "disney-adk"
    help
        Disney+ development kit

if BR2_PACKAGE_DISNEY
menu "Extra options"

choice
    bool "Build type"
    default BR2_PACKAGE_DISNEY_BUILD_DEBUG
config BR2_PACKAGE_DISNEY_BUILD_DEBUG
    bool "Debug"
config BR2_PACKAGE_DISNEY_BUILD_RELEASE
    bool "Release"
config BR2_PACKAGE_DISNEY_BUILD_PRODUCTION
    bool "Production"
endchoice

choice
    bool "Build target"
    default BR2_PACKAGE_DISNEY_TARGET_WPE
config BR2_PACKAGE_DISNEY_TARGET_WPE
    bool "WPE"
endchoice

choice
    bool "Player library"
    default BR2_PACKAGE_DISNEY_PLAYER_NONE
config BR2_PACKAGE_DISNEY_PLAYER_NONE
    bool "No player"
config BR2_PACKAGE_DISNEY_PLAYER_UMA
    select BR2_PACKAGE_DISNEY_UMA
    select BR2_PACKAGE_DISNEY_LIBOPENSSL
    bool "UMA"
endchoice

config BR2_PACKAGE_DISNEY_VERBOSE
    bool "Verbose output"
    default n

choice
    bool "[DEPERCATED] WPE version"
    default BR2_PACKAGE_DISNEY_WPE_NONE
config BR2_PACKAGE_DISNEY_WPE_NONE
    bool "NONE"
config BR2_PACKAGE_DISNEY_WPE_R3
    bool "R3"
config BR2_PACKAGE_DISNEY_WPE_R2
    bool "R2"
help
    Deprecated, wpe version should be taken from the define inside required library or framework.
endchoice

config BR2_PACKAGE_DISNEY_NON_DEBUG_TRACES
    bool "Enable traces on all builds"
    default n
    help
        Enable debug logs on release/ship builds

config BR2_PACKAGE_DISNEY_NATIVE_AUDIO
    bool "Native audio"
    default n
    help
        Enforce using native audio formats only

config BR2_PACKAGE_DISNEY_NATIVE_VIDEO
    bool "Native video"
    default y
    help
        Enforce using native video formats only

config BR2_PACKAGE_DISNEY_LINK_LIBRARY
    bool "Build M5 library"
    default y
    help
        Disney+ M5 shared library

config BR2_PACKAGE_DISNEY_LINK_EXECUTABLE
    bool "Build Merlin executable"
    default n
    help
        Disney+ Merlin executable

menu "Test tools"
    config BR2_PACKAGE_DISNEY_LINK_TESTS
    bool "Build ADK test suite"
    default n
    help
        Disney+ tests

    config BR2_PACKAGE_DISNEY_TOOLING_SHIELD_AGENT
    select BR2_PACKAGE_DISNEY_TOOLING
    bool "Build SHIELD Agent"
    default n
    help
        Build SHIELD Agent (Development tool)
    comment "SHIELD Agent depens on disney-tooling"
        depends on !BR2_PACKAGE_DISNEY_TOOLING

    config BR2_PACKAGE_DISNEY_TOOLING_SHIELD_EXTENSION
    select BR2_PACKAGE_DISNEY_TOOLING
    bool "Build SHIELD Extension"
    default n
    help
        Build SHIELD Extension (Integration test tool)
    comment "SHIELD Extension depens on disney-tooling"
        depends on !BR2_PACKAGE_DISNEY_TOOLING

    config BR2_PACKAGE_DISNEY_TOOLING_SHIELD_ASSISTANT
    bool "Build SHIELD assistant"
    default n
    help
        Build SHIELD assistant - our component enahncing running morgana and shield-agent.
    depends on BR2_PACKAGE_DISNEY_TOOLING && BR2_PACKAGE_WPEFRAMEWORK_DISNEYPLUS && (BR2_PACKAGE_DISNEY_TOOLING_SHIELD_AGENT || BR2_PACKAGE_DISNEY_TOOLING_SHIELD_EXTENSION)

    config BR2_PACKAGE_DISNEY_INSTALL_CERTIFICATES
    bool "Install tooling certificates"
    default n
    help
        Install certificates to connect to the disney platform
    comment "Installing certificates depends on disney-uma"
        depends on !BR2_PACKAGE_DISNEY_UMA

    config BR2_PACKAGE_DISNEY_MORGANA_SHARED_LIB
    bool "Morgana sharedlib"
    default n
    help
        Build morgana as .so instead of normal executable
    comment "SHIELD Agent depens on disney-tooling"
        depends on !BR2_PACKAGE_DISNEY_TOOLING
endmenu


endmenu
endif

source "package/disney/disney-uma/Config.in"
source "package/disney/disney-libopenssl/Config.in"
source "package/disney/disney-tooling/Config.in"
```

## package/disney/disney-tooling/Config.in
```kconfig
config BR2_PACKAGE_DISNEY_TOOLING
    bool "disney-tooling"
    default n
    help
        Disney+ Tooling
```

## package/gstreamer1/gst1-bluetoothaudiosource/Config.in
```kconfig
config BR2_PACKAGE_GST1_BLUETOOTHAUDIOSOURCE
    bool "gst1-bluetoothaudiosource"
    help
      GStreamer plug-in for receiving audio from Bluetooth source devices.
```

## package/unifdef/Config.in
```kconfig
config BR2_PACKAGE_UNIFDEF
        bool "unifdef"
        help
          unifdef
```

## package/wpe/cog/Config.in
```kconfig
config BR2_PACKAGE_COG
	bool "cog"
    depends on BR2_PACKAGE_WPEWEBKIT
	help
	  WPE launcher and webapp container
```

## package/wpe/wpebackend-rdk/Config.in
```kconfig
config BR2_PACKAGE_WPEBACKEND_RDK
	bool "wpebackend-rdk"
    select BR2_PACKAGE_WAYLAND_EGL_BNXS if BR2_PACKAGE_HAS_NEXUS && BR2_PACKAGE_WESTEROS
    select BR2_PACKAGE_LIBXKBCOMMON if BR2_PACKAGE_HAS_NEXUS && BR2_PACKAGE_WPEFRAMEWORK_COMPOSITOR
	help
	  RDK-specific implementations of the WPEBackend interfaces.
```
